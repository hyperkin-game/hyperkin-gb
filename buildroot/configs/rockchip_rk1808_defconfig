## buildroot/configs/rockchip_rk1808_defconfig
```kconfig
#include "rk1808_arm64.config"
#include "base.config"
#include "base_extra.config"
#include "debug.config"
#include "audio.config"
#include "wifi.config"
#include "bt.config"
BR2_PACKAGE_RKWIFIBT_COMPATIBLE=y
BR2_TARGET_GENERIC_HOSTNAME="rk1808"
BR2_TARGET_GENERIC_ISSUE="Welcome to RK1808 Buildroot"
BR2_PACKAGE_MINIGUI=y
BR2_PACKAGE_LIBDRM=y
BR2_PACKAGE_ROCKCHIP_TEST=y
BR2_PACKAGE_RKNPU=y
```

## buildroot/configs/rockchip_rk2818_game_defconfig
```kconfig
#include "base.config"
#include "rk2818_arm.config"
#include "audio.config"
#include "debug.config"
BR2_TARGET_GENERIC_HOSTNAME="rk2818"
BR2_TARGET_GENERIC_ISSUE="Welcome to RK2818 Buildroot"
BR2_ROOTFS_DEVICE_CREATION_DYNAMIC_EUDEV=y
BR2_PACKAGE_MINIGUI=y
BR2_PACKAGE_PARTINIT=y
BR2_PACKAGE_MINIGUI_GAME=y
BR2_PACKAGE_INPUT_EVENT_DAEMON=y
BR2_PACKAGE_USBMOUNT=y
BR2_PACKAGE_ANDROID_TOOLS=y
BR2_PACKAGE_RETROARCH=y
BR2_PACKAGE_LIBRETRO_QUICKNES=y
```

## buildroot/configs/rockchip_rk3036_defconfig
```kconfig
#include "rk3036_arm.config"
#include "base.config"
#include "base_extra.config"
#include "gpu.config"
#include "video_mpp.config"
#include "video_gst.config"
#include "audio.config"
#include "test.config"
#include "debug.config"
#include "benchmark.config"
#include "wifi.config"
#include "bt.config"
#include "qt.config"
#include "qt_app.config"
BR2_TARGET_GENERIC_HOSTNAME="rk3036"
BR2_TARGET_GENERIC_ISSUE="Welcome to RK3036 Buildroot"
BR2_PACKAGE_RKWIFIBT_COMPATIBLE=y
```

## buildroot/configs/rockchip_rk3128_brk01_kevin_defconfig
```kconfig
#include "base.config"
#include "rk3128_arm.config"
#include "base_extra.config"
#include "gpu.config"
#include "test.config"
BR2_TARGET_GENERIC_HOSTNAME="BRK01"
BR2_TARGET_GENERIC_ISSUE="Welcome to BRK01 Buildroot"
BR2_PACKAGE_MPP=y
BR2_PACKAGE_MPP_ALLOCATOR_DRM=y
BR2_PACKAGE_IO=y
BR2_PACKAGE_ALSA_CONFIG=y
BR2_PACKAGE_ALSA_UTILS=y
BR2_PACKAGE_ALSA_UTILS_ALSACONF=y
BR2_PACKAGE_ALSA_UTILS_AMIXER=y
BR2_PACKAGE_ALSA_UTILS_APLAY=y
BR2_PACKAGE_ALSA_PLUGINS=y
BR2_PACKAGE_FFMPEG=y
BR2_PACKAGE_FFMPEG_SWSCALE=y
#BR2_PACKAGE_HYPERKIN_LOADING=y
BR2_PACKAGE_KEVIN_TEST=y
BR2_PACKAGE_FBV=y
BR2_PACKAGE_SDL2=y
BR2_PACKAGE_SDL2_KMSDRM=y
BR2_PACKAGE_SDL2_OPENGLES=y
BR2_PACKAGE_SDL2_GFX=y
BR2_PACKAGE_SDL2_IMAGE=y
BR2_PACKAGE_SDL2_MIXER=y
BR2_PACKAGE_SDL2_TTF=y
BR2_PACKAGE_EVTEST=y
BR2_PACKAGE_LIBDRM_INSTALL_TESTS=y
#BR2_PACKAGE_RETROARCH=y
BR2_PACKAGE_LIBRETRO_MGBA=y
BR2_PACKAGE_LIBRETRO_VBAM=y
BR2_PACKAGE_EVEMU=y
```

## buildroot/configs/rockchip_rk3128_defconfig
```kconfig
#include "rk3128_arm.config"
#include "base.config"
#include "base_extra.config"
#include "gpu.config"
#include "video_mpp.config"
#include "video_gst.config"
#include "audio.config"
#include "camera.config"
#include "camera_gst.config"
#include "test.config"
#include "debug.config"
#include "benchmark.config"
#include "wifi.config"
#include "bt.config"
#include "qt.config"
#include "qt_app.config"
BR2_TARGET_GENERIC_HOSTNAME="rk3128"
BR2_TARGET_GENERIC_ISSUE="Welcome to RK3128 Buildroot"
BR2_PACKAGE_RKWIFIBT_COMPATIBLE=y
```

## buildroot/configs/rockchip_rk3128_game_defconfig
```kconfig
#include "base.config"
#include "rk3128_arm.config"
#include "base_extra.config"
#include "gpu.config"
#include "test.config"
BR2_TARGET_GENERIC_HOSTNAME="rk3128"
BR2_TARGET_GENERIC_ISSUE="Welcome to rk3128 Buildroot"
BR2_PACKAGE_MPP=y
BR2_PACKAGE_MPP_ALLOCATOR_DRM=y
BR2_PACKAGE_IO=y
BR2_PACKAGE_MINIGUI=y
BR2_PACKAGE_ALSA_CONFIG=y
BR2_PACKAGE_MINIGUI_GAME=y
BR2_PACKAGE_ALSA_UTILS=y
BR2_PACKAGE_ALSA_UTILS_ALSACONF=y
BR2_PACKAGE_ALSA_UTILS_AMIXER=y
BR2_PACKAGE_ALSA_UTILS_APLAY=y
BR2_PACKAGE_ALSA_PLUGINS=y
BR2_PACKAGE_FFMPEG=y
BR2_PACKAGE_FFMPEG_FFPLAY=y
BR2_PACKAGE_SDL2_KMSDRM=y
BR2_PACKAGE_SDL2_OPENGLES=y
BR2_PACKAGE_EVTEST=y
BR2_PACKAGE_LIBDRM_INSTALL_TESTS=y
BR2_PACKAGE_RETROARCH=y
BR2_PACKAGE_LIBRETRO_FBALPHA2012=y
BR2_PACKAGE_LIBRETRO_FCEUMM=y
BR2_PACKAGE_LIBRETRO_GENESISPLUSGX=y
```

## buildroot/configs/rockchip_rk3288_defconfig
```kconfig
#include "rk3288_arm.config"
#include "base.config"
#include "base_extra.config"
#include "gpu.config"
#include "video_mpp.config"
#include "video_gst.config"
#include "audio.config"
#include "camera.config"
#include "camera_gst.config"
#include "test.config"
#include "debug.config"
#include "benchmark.config"
#include "wifi.config"
#include "bt.config"
#include "qt.config"
#include "qt_app.config"
BR2_TARGET_GENERIC_HOSTNAME="rk3288"
BR2_TARGET_GENERIC_ISSUE="Welcome to RK3288 Buildroot"
BR2_PACKAGE_RKWIFIBT_COMPATIBLE=y
BR2_PACKAGE_RKWIFIBT_BTUART="ttyS0"
```

## buildroot/configs/rockchip_rk3308_robot64_defconfig
```kconfig
#include "rk3308_arm64.config"
#include "base.config"
#include "base_extra.config"
#include "audio.config"
#include "debug.config"
#include "wifi.config"
BR2_TARGET_GENERIC_HOSTNAME="rk3308_robot"
BR2_TARGET_GENERIC_ISSUE="Welcome to RK3308 Buildroot"
BR2_PACKAGE_RKWIFIBT_AP6255=y
```

## buildroot/configs/rockchip_rk3326_32_defconfig
```kconfig
#include "rk3326_arm.config"
#include "base.config"
#include "base_extra.config"
#include "gpu.config"
#include "video_mpp.config"
#include "video_gst.config"
#include "audio.config"
#include "camera.config"
#include "test.config"
#include "debug.config"
#include "benchmark.config"
#include "wifi.config"
#include "bt.config"
#include "qt.config"
#include "qt_app.config"
BR2_TARGET_GENERIC_HOSTNAME="rk3326_32"
BR2_TARGET_GENERIC_ISSUE="Welcome to RK3326 Buildroot"
BR2_ROOTFS_OVERLAY="board/rockchip/rk3326/fs-overlay-32/"
BR2_PACKAGE_RKWIFIBT_COMPATIBLE=y
```

## buildroot/configs/rockchip_rk3326_robot32_defconfig
```kconfig
#include "rk3326_arm.config"
#include "base.config"
#include "base_extra.config"
#include "gpu.config"
#include "audio.config"
#include "camera.config"
#include "debug.config"
#include "wifi.config"
BR2_TARGET_GENERIC_HOSTNAME="rk3326_robot"
BR2_TARGET_GENERIC_ISSUE="Welcome to RK3326 Buildroot"
BR2_ROOTFS_OVERLAY="board/rockchip/rk3326/fs-overlay-32/"
BR2_PACKAGE_RKWIFIBT_AP6212A1=y
```

## buildroot/configs/rockchip_rk3399_defconfig
```kconfig
#include "rk3399_arm64.config"
#include "base.config"
#include "base_extra.config"
#include "gpu.config"
#include "video_mpp.config"
#include "video_gst.config"
#include "audio.config"
#include "camera.config"
#include "camera_gst.config"
#include "test.config"
#include "debug.config"
#include "benchmark.config"
#include "wifi.config"
#include "bt.config"
#include "qt.config"
#include "qt_app.config"
BR2_TARGET_GENERIC_HOSTNAME="rk3399"
BR2_TARGET_GENERIC_ISSUE="Welcome to RK3399 Buildroot"
BR2_PACKAGE_RKWIFIBT_COMPATIBLE=y
#  - The rk3399 evb used the ttyS0 by default.
BR2_PACKAGE_RKWIFIBT_BTUART="ttyS0"
```

## buildroot/configs/rockchip_rk3399pro_npu_defconfig
```kconfig
#include "rk3399pro_npu_arm64.config"
#include "base.config"
BR2_ROOTFS_DEVICE_CREATION_DYNAMIC_MDEV=y
BR2_PACKAGE_PROCRANK_LINUX=y
BR2_PACKAGE_IO=y
BR2_PACKAGE_LIBUSB=y
BR2_PACKAGE_RKNPU=y
BR2_PACKAGE_LIBXML2=y
BR2_PACKAGE_POWERMANAGER=y
```

## buildroot/package/glibc/Config.in
```kconfig
if BR2_TOOLCHAIN_BUILDROOT_GLIBC

config BR2_PACKAGE_GLIBC
	bool
	default y
	select BR2_PACKAGE_LINUX_HEADERS
	select BR2_TOOLCHAIN_HAS_SSP

if BR2_PACKAGE_GLIBC

config BR2_PACKAGE_GLIBC_2_22
	bool "glibc 2.22"
	default y if !BR2_TOOLCHAIN_HEADERS_AT_LEAST_3_2
	# No support for pthread barriers on < v9 ISA
	depends on !BR2_sparc

endif

endif
```

## buildroot/package/hyperkin-loading/Config.in
```kconfig
config BR2_PACKAGE_HYPERKIN_LOADING
	bool "hyperkin_loading"
	help

	hyperkin show loading pictures tools.
```

## buildroot/package/rockchip/minigui/Config.in
```kconfig
config BR2_PACKAGE_MINIGUI
	bool "Minigui core lib"
	select BR2_PACKAGE_LIBPNG
	select BR2_PACKAGE_JPEG
	select BR2_PACKAGE_FREETYPE
	select BR2_PACKAGE_PIXMAN if BR2_PACKAGE_LIBDRM
	help
          http://www.minigui.org
```

## buildroot/package/rockchip/minigui_game/Config.in
```kconfig
config BR2_PACKAGE_MINIGUI_GAME
	bool "Minigui demo launcher of game"
	depends on BR2_PACKAGE_MINIGUI
	help
	  Minigui demo launcher
```

## kernel/arch/arm/configs/rk3128_brk01_defconfig
```kconfig
# CONFIG_LOCALVERSION_AUTO is not set
CONFIG_DEFAULT_HOSTNAME="localhost"
CONFIG_SYSVIPC=y
CONFIG_FHANDLE=y
CONFIG_NO_HZ=y
CONFIG_HIGH_RES_TIMERS=y
CONFIG_IKCONFIG=y
CONFIG_IKCONFIG_PROC=y
CONFIG_LOG_BUF_SHIFT=18
CONFIG_CGROUPS=y
CONFIG_CGROUP_FREEZER=y
CONFIG_CGROUP_DEVICE=y
CONFIG_CPUSETS=y
CONFIG_CGROUP_CPUACCT=y
CONFIG_CGROUP_SCHED=y
CONFIG_CFS_BANDWIDTH=y
CONFIG_NAMESPACES=y
CONFIG_USER_NS=y
CONFIG_RELAY=y
CONFIG_CC_OPTIMIZE_FOR_SIZE=y
CONFIG_EMBEDDED=y
# CONFIG_COMPAT_BRK is not set
CONFIG_PROFILING=y
CONFIG_MODULES=y
CONFIG_MODULE_FORCE_LOAD=y
CONFIG_MODULE_UNLOAD=y
CONFIG_MODULE_FORCE_UNLOAD=y
CONFIG_PARTITION_ADVANCED=y
CONFIG_MAC_PARTITION=y
CONFIG_ARCH_ROCKCHIP=y
CONFIG_ARM_THUMBEE=y
CONFIG_ARM_KERNMEM_PERMS=y
# CONFIG_ARM_ERRATA_643719 is not set
CONFIG_SMP=y
CONFIG_ARM_PSCI=y
CONFIG_PREEMPT_VOLUNTARY=y
CONFIG_AEABI=y
CONFIG_HIGHMEM=y
# CONFIG_HIGHPTE is not set
# CONFIG_COMPACTION is not set
CONFIG_DEFAULT_MMAP_MIN_ADDR=32768
CONFIG_FRONTSWAP=y
CONFIG_CMA=y
CONFIG_ZSWAP=y
CONFIG_ZSMALLOC=y
CONFIG_SECCOMP=y
CONFIG_ZBOOT_ROM_TEXT=0x0
CONFIG_ZBOOT_ROM_BSS=0x0
CONFIG_ARM_APPENDED_DTB=y
CONFIG_ARM_ATAG_DTB_COMPAT=y
CONFIG_ARM_ATAG_DTB_COMPAT_CMDLINE_EXTEND=y
CONFIG_CPU_FREQ=y
CONFIG_CPU_FREQ_DEFAULT_GOV_INTERACTIVE=y
CONFIG_CPU_FREQ_GOV_PERFORMANCE=y
CONFIG_CPU_FREQ_GOV_POWERSAVE=y
CONFIG_CPU_FREQ_GOV_USERSPACE=y
CONFIG_CPU_FREQ_GOV_ONDEMAND=y
CONFIG_CPU_FREQ_GOV_CONSERVATIVE=y
CONFIG_CPUFREQ_DT=y
CONFIG_ARM_ROCKCHIP_CPUFREQ=y
CONFIG_CPU_IDLE=y
CONFIG_VFP=y
CONFIG_NEON=y
CONFIG_PM_DEBUG=y
CONFIG_PM_ADVANCED_DEBUG=y
CONFIG_NET=y
CONFIG_PACKET=y
CONFIG_UNIX=y
CONFIG_XFRM_USER=y
CONFIG_NET_KEY=y
CONFIG_INET=y
CONFIG_INET_AH=y
CONFIG_INET_ESP=y
CONFIG_INET_IPCOMP=y
# CONFIG_INET_DIAG is not set
# CONFIG_IPV6 is not set
# CONFIG_ANDROID_PARANOID_NETWORK is not set
CONFIG_DNS_RESOLVER=y
# CONFIG_WIRELESS is not set
CONFIG_DEVTMPFS=y
CONFIG_DEVTMPFS_MOUNT=y
CONFIG_DEBUG_DEVRES=y
CONFIG_DMA_CMA=y
CONFIG_CONNECTOR=y
CONFIG_ZRAM=y
CONFIG_SCSI=y
CONFIG_SCSI_PROC_FS=y
CONFIG_BLK_DEV_SD=y
CONFIG_BLK_DEV_SR=y
CONFIG_CHR_DEV_SG=y
CONFIG_SCSI_LOWLEVEL=y
CONFIG_NETDEVICES=y
# CONFIG_ETHERNET is not set
# CONFIG_USB_NET_DRIVERS is not set
# CONFIG_WLAN is not set
CONFIG_INPUT_MATRIXKMAP=y
# CONFIG_INPUT_MOUSEDEV is not set
CONFIG_INPUT_JOYDEV=y
CONFIG_INPUT_EVDEV=y
CONFIG_KEYBOARD_ADC=y
CONFIG_KEYBOARD_GPIO=y
CONFIG_KEYBOARD_GPIO_POLLED=y
# CONFIG_MOUSE_PS2 is not set
CONFIG_INPUT_JOYSTICK=y
CONFIG_JOYSTICK_IFORCE=y
CONFIG_JOYSTICK_IFORCE_USB=y
CONFIG_JOYSTICK_XPAD=y
CONFIG_JOYSTICK_XPAD_FF=y
CONFIG_INPUT_MISC=y
#CONFIG_INPUT_ADC_POT is not set
CONFIG_INPUT_ADC_VOL=y
CONFIG_INPUT_RK8XX_PWRKEY=y
CONFIG_VT_HW_CONSOLE_BINDING=y
CONFIG_DEVPTS_MULTIPLE_INSTANCES=y
# CONFIG_LEGACY_PTYS is not set
# CONFIG_DEVKMEM is not set
CONFIG_SERIAL_8250=y
CONFIG_SERIAL_8250_CONSOLE=y
CONFIG_SERIAL_8250_NR_UARTS=5
CONFIG_SERIAL_8250_RUNTIME_UARTS=5
CONFIG_SERIAL_8250_DW=y
CONFIG_SERIAL_OF_PLATFORM=y
CONFIG_HW_RANDOM=y
CONFIG_I2C_CHARDEV=y
CONFIG_I2C_RK3X=y
CONFIG_SPI=y
CONFIG_SPI_BITBANG=y
CONFIG_SPI_ROCKCHIP=y
CONFIG_SPI_SPIDEV=y
CONFIG_DEBUG_GPIO=y
CONFIG_GPIO_SYSFS=y
CONFIG_GPIO_GENERIC_PLATFORM=y
CONFIG_BATTERY_SBS=y
CONFIG_CHARGER_GPIO=y
CONFIG_POWER_RESET=y
CONFIG_POWER_RESET_GPIO_RESTART=y
CONFIG_SYSCON_REBOOT_MODE=y
# CONFIG_HWMON is not set
CONFIG_MFD_RK808=y
CONFIG_REGULATOR_FIXED_VOLTAGE=y
CONFIG_REGULATOR_PWM=y
CONFIG_REGULATOR_RK808=y
CONFIG_REGULATOR_RK818=y
CONFIG_MEDIA_SUPPORT=y
CONFIG_MEDIA_CAMERA_SUPPORT=y
CONFIG_V4L_PLATFORM_DRIVERS=y
CONFIG_V4L_MEM2MEM_DRIVERS=y
CONFIG_VIDEO_ROCKCHIP_VPU=y
CONFIG_DRM=y
CONFIG_DRM_ROCKCHIP=y
CONFIG_ROCKCHIP_INNO_HDMI=y
CONFIG_ROCKCHIP_LVDS=y
CONFIG_DRM_PANEL_SIMPLE=y
CONFIG_MALI400=y
# CONFIG_MALI400_PROFILING is not set
CONFIG_MALI_SHARED_INTERRUPTS=y
CONFIG_MALI_DT=y
CONFIG_MALI_DEVFREQ=y
CONFIG_FB_MODE_HELPERS=y
CONFIG_BACKLIGHT_LCD_SUPPORT=y
# CONFIG_LCD_CLASS_DEVICE is not set
CONFIG_BACKLIGHT_CLASS_DEVICE=y
# CONFIG_BACKLIGHT_GENERIC is not set
CONFIG_BACKLIGHT_PWM=y
CONFIG_RK_VCODEC=y
CONFIG_SOUND=y
CONFIG_SND=y
CONFIG_SND_SEQUENCER=y
CONFIG_SND_SEQ_DUMMY=y
CONFIG_SND_HRTIMER=y
CONFIG_SND_DYNAMIC_MINORS=y
# CONFIG_SND_ARM is not set
# CONFIG_SND_SPI is not set
CONFIG_SND_SOC=y
CONFIG_SND_SOC_ROCKCHIP=y
CONFIG_SND_SOC_ROCKCHIP_I2S=y
CONFIG_SND_SOC_RK312X=y
CONFIG_SND_SIMPLE_CARD=y
CONFIG_HID_BATTERY_STRENGTH=y
CONFIG_USB_HIDDEV=y
CONFIG_USB_ANNOUNCE_NEW_DEVICES=y
# CONFIG_USB_DEFAULT_PERSIST is not set
CONFIG_USB_OTG=y
# CONFIG_USB_MON is not set
CONFIG_USB_EHCI_HCD=y
CONFIG_USB_EHCI_ROOT_HUB_TT=y
CONFIG_USB_EHCI_HCD_PLATFORM=y
CONFIG_USB_OHCI_HCD=y
CONFIG_USB_OHCI_HCD_PLATFORM=y
CONFIG_USB_STORAGE=y
CONFIG_USB_DWC2=y
CONFIG_USB_GADGET=y
CONFIG_USB_GADGET_DEBUG_FILES=y
CONFIG_USB_GADGET_VBUS_DRAW=500
CONFIG_USB_CONFIGFS=y
CONFIG_USB_CONFIGFS_MASS_STORAGE=y
CONFIG_USB_CONFIGFS_F_FS=y
CONFIG_USB_CONFIGFS_UEVENT=y
CONFIG_MMC=y
CONFIG_MMC_BLOCK_MINORS=16
CONFIG_MMC_DW=y
CONFIG_MMC_DW_ROCKCHIP=y
CONFIG_NEW_LEDS=y
CONFIG_SWITCH=y
CONFIG_SWITCH_GPIO=y
CONFIG_RTC_CLASS=y
CONFIG_RTC_DRV_RK808=y
CONFIG_DMADEVICES=y
CONFIG_PL330_DMA=y
CONFIG_STAGING=y
CONFIG_FIQ_DEBUGGER=y
CONFIG_FIQ_DEBUGGER_NO_SLEEP=y
CONFIG_FIQ_DEBUGGER_CONSOLE=y
CONFIG_FIQ_DEBUGGER_CONSOLE_DEFAULT_ENABLE=y
CONFIG_FIQ_DEBUGGER_TRUST_ZONE=y
CONFIG_COMMON_CLK_RK808=y
CONFIG_ROCKCHIP_IOMMU=y
# CONFIG_CPU_RK3036 is not set
# CONFIG_CPU_RK30XX is not set
# CONFIG_CPU_RK3288 is not set
# CONFIG_CPU_RK322X is not set
CONFIG_ROCKCHIP_PM_DOMAINS=y
CONFIG_ROCKCHIP_PVTM=y
CONFIG_PM_DEVFREQ=y
CONFIG_DEVFREQ_GOV_PERFORMANCE=y
CONFIG_DEVFREQ_GOV_POWERSAVE=y
CONFIG_DEVFREQ_GOV_USERSPACE=y
CONFIG_ARM_ROCKCHIP_DMC_DEVFREQ=y
CONFIG_PM_DEVFREQ_EVENT=y
CONFIG_MEMORY=y
CONFIG_IIO=y
CONFIG_IIO_BUFFER=y
CONFIG_IIO_KFIFO_BUF=y
CONFIG_IIO_TRIGGER=y
CONFIG_ROCKCHIP_SARADC=y
CONFIG_IIO_SYSFS_TRIGGER=y
CONFIG_PWM=y
CONFIG_PWM_ROCKCHIP=y
CONFIG_PHY_ROCKCHIP_USB=y
CONFIG_PHY_ROCKCHIP_INNO_USB2=y
CONFIG_PHY_ROCKCHIP_INNO_HDMI_PHY=y
CONFIG_ANDROID=y
CONFIG_NVMEM=y
CONFIG_ROCKCHIP_EFUSE=y
CONFIG_RK_FLASH=y
CONFIG_RK_SFC_NAND=y
CONFIG_RK_SFC_NOR=y
CONFIG_ROCKCHIP_SIP=y
CONFIG_EXT4_FS=y
CONFIG_EXT4_FS_POSIX_ACL=y
CONFIG_EXT4_FS_SECURITY=y
# CONFIG_DNOTIFY is not set
CONFIG_FUSE_FS=y
CONFIG_VFAT_FS=y
CONFIG_FAT_DEFAULT_CODEPAGE=936
CONFIG_FAT_DEFAULT_IOCHARSET="utf8"
CONFIG_TMPFS=y
CONFIG_TMPFS_POSIX_ACL=y
CONFIG_HFSPLUS_FS=y
CONFIG_SQUASHFS=y
CONFIG_SQUASHFS_LZO=y
CONFIG_PSTORE=y
CONFIG_PSTORE_CONSOLE=y
CONFIG_PSTORE_RAM=y
# CONFIG_NETWORK_FILESYSTEMS is not set
CONFIG_NLS_DEFAULT="utf8"
CONFIG_NLS_CODEPAGE_437=y
CONFIG_NLS_CODEPAGE_936=y
CONFIG_NLS_CODEPAGE_932=y
CONFIG_NLS_CODEPAGE_949=y
CONFIG_NLS_ASCII=y
CONFIG_NLS_ISO8859_1=y
CONFIG_PRINTK_TIME=y
CONFIG_DEBUG_INFO=y
CONFIG_DEBUG_FS=y
CONFIG_MAGIC_SYSRQ=y
CONFIG_MAGIC_SYSRQ_DEFAULT_ENABLE=0
CONFIG_LOCKUP_DETECTOR=y
CONFIG_BOOTPARAM_SOFTLOCKUP_PANIC=y
CONFIG_BOOTPARAM_HUNG_TASK_PANIC=y
CONFIG_PANIC_TIMEOUT=2
CONFIG_SCHEDSTATS=y
CONFIG_TIMER_STATS=y
CONFIG_DEBUG_SPINLOCK=y
CONFIG_STACKTRACE=y
CONFIG_DEBUG_CREDENTIALS=y
CONFIG_RCU_CPU_STALL_TIMEOUT=60
# CONFIG_FTRACE is not set
CONFIG_LKDTM=y
CONFIG_TEST_UDELAY=y
CONFIG_STRICT_DEVMEM=y
CONFIG_DEBUG_SET_MODULE_RONX=y
CONFIG_KEYS=y
CONFIG_CRYPTO_CCM=y
CONFIG_CRYPTO_GCM=y
CONFIG_CRYPTO_CMAC=y
CONFIG_CRYPTO_SHA512=y
CONFIG_CRYPTO_ARC4=y
CONFIG_CRYPTO_LZ4=y
CONFIG_CRYPTO_USER_API_HASH=y
CONFIG_CRYPTO_USER_API_SKCIPHER=y
CONFIG_ASYMMETRIC_KEY_TYPE=y
CONFIG_ASYMMETRIC_PUBLIC_KEY_SUBTYPE=y
CONFIG_X509_CERTIFICATE_PARSER=y
CONFIG_PKCS7_MESSAGE_PARSER=y
CONFIG_SYSTEM_TRUSTED_KEYRING=y
CONFIG_CRC_CCITT=y
CONFIG_CRC_T10DIF=y
CONFIG_CRC_ITU_T=y
CONFIG_CRC7=y
CONFIG_LIBCRC32C=y
CONFIG_XZ_DEC=y
# CONFIG_XZ_DEC_X86 is not set
# CONFIG_XZ_DEC_POWERPC is not set
# CONFIG_XZ_DEC_IA64 is not set
# CONFIG_XZ_DEC_SPARC is not set
CONFIG_MESSAGE_LOGLEVEL_DEFAULT=7
```
